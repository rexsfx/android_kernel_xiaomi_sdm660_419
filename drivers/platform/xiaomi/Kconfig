## drivers/platform/xiaomi/Kconfig
```kconfig
config XIAOMI_WHYRED
	default n
	bool "Custom for hardware E7S_pcb"
	help
	  Custom for E7S_pcb.

config XIAOMI_NEW_CAMERA
	default n
	bool "Xiaomi new camera blobs"
	help
	  Support for new camera blobs
```
